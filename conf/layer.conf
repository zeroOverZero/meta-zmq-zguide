## conf/layer.conf
```bitbake
# We have a conf and classes directory, add to BBPATH
BBPATH .= ":${LAYERDIR}"

# We have a packages directory, add to BBFILES
BBFILES += " \
    ${LAYERDIR}/recipes-*/*/*.bb \
    ${LAYERDIR}/recipes-*/*/*.bbappend \
    "

BBFILE_COLLECTIONS += "zmq-zguide"
BBFILE_PRIORITY_zmq-zguide = "5"
BBFILE_PATTERN_zmq-zguide = "^${LAYERDIR}/"

LAYERSERIES_COMPAT_zmq-zguide = "thud"
```
